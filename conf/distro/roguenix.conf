## conf/distro/roguenix.conf
```bitbake
require conf/distro/poky.conf

IMAGE_FSTYPES:append = " wic"

LICENSE_FLAGS_ACCEPTED = "synaptics-killswitch"

RPI_USE_U_BOOT = "1"

ENABLE_UART = "1"

DISABLE_RPI_BOOT_LOGO = "1"

PACKAGE_CLASSES = "package_deb"

INIT_MANAGER = "systemd"

DISTRO_FEATURES:append = " systemd usrmerge"
VIRTUAL-RUNTIME_init_manager = "systemd"
VIRTUAL-RUNTIME_initscripts = ""

DISTRO_FEATURES:remove = "connman"

NETWORK_MANAGER = "networkmanager"
```
